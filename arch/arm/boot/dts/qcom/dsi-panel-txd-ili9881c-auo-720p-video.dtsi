/* Copyright (c) 2013, The Linux Foundation. All rights reserved.
 *
 * This program is free software; you can redistribute it and/or modify
 * it under the terms of the GNU General Public License version 2 and
 * only version 2 as published by the Free Software Foundation.
 *
 * This program is distributed in the hope that it will be useful,
 * but WITHOUT ANY WARRANTY; without even the implied warranty of
 * MERCHANTABILITY or FITNESS FOR A PARTICULAR PURPOSE.  See the
 * GNU General Public License for more details.
 */

/*---------------------------------------------------------------------------
 * This file is autogenerated file using gcdb parser. Please do not edit it.
 * Update input XML file to add a new entry or update variable in this file
 * VERSION = "1.0"
 *---------------------------------------------------------------------------*/
&mdss_mdp {
	dsi_txd_ili9881c_720p_auo_video: qcom,mdss_dsi_txd_ili9881c_720p_auo_video {
		qcom,mdss-dsi-panel-name = "txd_ili9881c_720p_auo_video_mode_dsi_panel";
		qcom,mdss-dsi-panel-controller = <&mdss_dsi0>;
		qcom,mdss-dsi-panel-type = "dsi_video_mode";
		qcom,mdss-dsi-panel-destination = "display_1";
		qcom,mdss-dsi-panel-framerate = <60>;
		qcom,mdss-dsi-virtual-channel-id = <0>;
		qcom,mdss-dsi-stream = <0>;
		qcom,mdss-dsi-panel-width = <720>;
		qcom,mdss-dsi-panel-height = <1280>;
		qcom,mdss-dsi-h-front-porch = <80>;
		qcom,mdss-dsi-h-back-porch = <80>;
		qcom,mdss-dsi-h-pulse-width = <60>;
		qcom,mdss-dsi-h-sync-skew = <0>;
		qcom,mdss-dsi-v-back-porch = <18>;
		qcom,mdss-dsi-v-front-porch = <10>;
		qcom,mdss-dsi-v-pulse-width = <4>;
		qcom,mdss-dsi-h-left-border = <0>;
		qcom,mdss-dsi-h-right-border = <0>;
		qcom,mdss-dsi-v-top-border = <0>;
		qcom,mdss-dsi-v-bottom-border = <0>;
		qcom,mdss-dsi-bpp = <24>;
		qcom,mdss-dsi-color-order = "rgb_swap_rgb";
		qcom,mdss-dsi-underflow-color = <0xff>;
		qcom,mdss-dsi-border-color = <0>;
		qcom,mdss-dsi-on-command = [39 01 00 00 00 00 04 ff 98 81 03
    39 01 00 00 00 00 02 01 08
    39 01 00 00 00 00 02 02 00
    39 01 00 00 00 00 02 03 73
    39 01 00 00 00 00 02 04 73
    39 01 00 00 00 00 02 05 14
    39 01 00 00 00 00 02 06 06
    39 01 00 00 00 00 02 07 02
    39 01 00 00 00 00 02 08 05
    39 01 00 00 00 00 02 09 00
    39 01 00 00 00 00 02 0a 0c
    39 01 00 00 00 00 02 0b 00
    39 01 00 00 00 00 02 0c 1c
    39 01 00 00 00 00 02 0d 1c
    39 01 00 00 00 00 02 0e 00
    39 01 00 00 00 00 02 0f 0c
    39 01 00 00 00 00 02 10 0c
    39 01 00 00 00 00 02 11 01
    39 01 00 00 00 00 02 12 01
    39 01 00 00 00 00 02 13 1b
    39 01 00 00 00 00 02 14 0b
    39 01 00 00 00 00 02 15 00
    39 01 00 00 00 00 02 16 00
    39 01 00 00 00 00 02 17 00
    39 01 00 00 00 00 02 18 00
    39 01 00 00 00 00 02 19 00
    39 01 00 00 00 00 02 1a 00
    39 01 00 00 00 00 02 1b 00
    39 01 00 00 00 00 02 1c 00
    39 01 00 00 00 00 02 1d 00
    39 01 00 00 00 00 02 1e c8
    39 01 00 00 00 00 02 1f 80
    39 01 00 00 00 00 02 20 02
    39 01 00 00 00 00 02 21 00
    39 01 00 00 00 00 02 22 02
    39 01 00 00 00 00 02 23 00
    39 01 00 00 00 00 02 24 00
    39 01 00 00 00 00 02 25 00
    39 01 00 00 00 00 02 26 00
    39 01 00 00 00 00 02 27 00
    39 01 00 00 00 00 02 28 fb
    39 01 00 00 00 00 02 29 43
    39 01 00 00 00 00 02 2a 00
    39 01 00 00 00 00 02 2b 00
    39 01 00 00 00 00 02 2c 07
    39 01 00 00 00 00 02 2d 07
    39 01 00 00 00 00 02 2e ff
    39 01 00 00 00 00 02 2f ff
    39 01 00 00 00 00 02 30 11
    39 01 00 00 00 00 02 31 00
    39 01 00 00 00 00 02 32 00
    39 01 00 00 00 00 02 33 00
    39 01 00 00 00 00 02 34 84
    39 01 00 00 00 00 02 35 80
    39 01 00 00 00 00 02 36 07
    39 01 00 00 00 00 02 37 00
    39 01 00 00 00 00 02 38 00
    39 01 00 00 00 00 02 39 00
    39 01 00 00 00 00 02 3a 00
    39 01 00 00 00 00 02 3b 00
    39 01 00 00 00 00 02 3c 00   
    39 01 00 00 00 00 02 3d 00
    39 01 00 00 00 00 02 3e 00
    39 01 00 00 00 00 02 3f 00
    39 01 00 00 00 00 02 40 00
    39 01 00 00 00 00 02 41 88
    39 01 00 00 00 00 02 42 00
    39 01 00 00 00 00 02 43 80
    39 01 00 00 00 00 02 44 08
    39 01 00 00 00 00 02 50 01
    39 01 00 00 00 00 02 51 23
    39 01 00 00 00 00 02 52 45
    39 01 00 00 00 00 02 53 67
    39 01 00 00 00 00 02 54 89
    39 01 00 00 00 00 02 55 ab
    39 01 00 00 00 00 02 56 01   
    39 01 00 00 00 00 02 57 23
    39 01 00 00 00 00 02 58 45
    39 01 00 00 00 00 02 59 67
    39 01 00 00 00 00 02 5a 89
    39 01 00 00 00 00 02 5b ab
    39 01 00 00 00 00 02 5c cd
    39 01 00 00 00 00 02 5d ef
    39 01 00 00 00 00 02 5e 10
    39 01 00 00 00 00 02 5f 02
    39 01 00 00 00 00 02 60 02
    39 01 00 00 00 00 02 61 02
    39 01 00 00 00 00 02 62 02
    39 01 00 00 00 00 02 63 02
    39 01 00 00 00 00 02 64 02
    39 01 00 00 00 00 02 65 02   
    39 01 00 00 00 00 02 66 08
    39 01 00 00 00 00 02 67 09
    39 01 00 00 00 00 02 68 02
    39 01 00 00 00 00 02 69 10
    39 01 00 00 00 00 02 6a 12
    39 01 00 00 00 00 02 6b 11
    39 01 00 00 00 00 02 6c 13
    39 01 00 00 00 00 02 6d 0c
    39 01 00 00 00 00 02 6e 0E
    39 01 00 00 00 00 02 6f 0d
    39 01 00 00 00 00 02 70 0f
    39 01 00 00 00 00 02 71 06
    39 01 00 00 00 00 02 72 07
    39 01 00 00 00 00 02 73 02
    39 01 00 00 00 00 02 74 02   
    39 01 00 00 00 00 02 75 02
    39 01 00 00 00 00 02 76 02
    39 01 00 00 00 00 02 77 02
    39 01 00 00 00 00 02 78 02
    39 01 00 00 00 00 02 79 02
    39 01 00 00 00 00 02 7a 02
    39 01 00 00 00 00 02 7b 02
    39 01 00 00 00 00 02 7c 07
    39 01 00 00 00 00 02 7d 06
    39 01 00 00 00 00 02 7e 02
    39 01 00 00 00 00 02 7f 11
    39 01 00 00 00 00 02 80 13
    39 01 00 00 00 00 02 81 10
    39 01 00 00 00 00 02 82 12
    39 01 00 00 00 00 02 83 0F   
    39 01 00 00 00 00 02 84 0d
    39 01 00 00 00 00 02 85 0e
    39 01 00 00 00 00 02 86 0c
    39 01 00 00 00 00 02 87 09
    39 01 00 00 00 00 02 88 08
    39 01 00 00 00 00 02 89 02
    39 01 00 00 00 00 02 8A 02
    39 01 00 00 00 00 04 ff 98 81 04
    39 01 00 00 00 00 02 00 00
    39 01 00 00 00 00 02 6C 15
    39 01 00 00 00 00 02 6E 2B
    39 01 00 00 00 00 02 6F 35
    39 01 00 00 00 00 02 3A A4
    39 01 00 00 00 00 02 8D 1F
    39 01 00 00 00 00 02 87 BA
    39 01 00 00 00 00 02 26 76   
    39 01 00 00 00 00 02 B2 D1
    39 01 00 00 00 00 02 69 57
    39 01 00 00 00 00 02 33 44
    39 01 00 00 00 00 02 88 0B
    39 01 00 00 00 00 04 ff 98 81 01
    39 01 00 00 00 00 02 22 0A
    39 01 00 00 00 00 02 31 0B
    39 01 00 00 00 00 02 53 64
    39 01 00 00 00 00 02 55 8f
    39 01 00 00 00 00 02 50 A7
    39 01 00 00 00 00 02 51 A7
    39 01 00 00 00 00 02 60 14
    39 01 00 00 00 00 02 A0 00
    39 01 00 00 00 00 02 A1 1f
    39 01 00 00 00 00 02 A2 2e
    39 01 00 00 00 00 02 A3 11   
    39 01 00 00 00 00 02 A4 13
    39 01 00 00 00 00 02 A5 27
    39 01 00 00 00 00 02 A6 1b
    39 01 00 00 00 00 02 A7 1b
    39 01 00 00 00 00 02 A8 8c
    39 01 00 00 00 00 02 A9 1c
    39 01 00 00 00 00 02 AA 29
    39 01 00 00 00 00 02 AB 80
    39 01 00 00 00 00 02 AC 1A
    39 01 00 00 00 00 02 AD 1A
    39 01 00 00 00 00 02 AE 4E
    39 01 00 00 00 00 02 AF 23
    39 01 00 00 00 00 02 B0 29
    39 01 00 00 00 00 02 B1 59
    39 01 00 00 00 00 02 B2 67   
    39 01 00 00 00 00 02 B3 39
    39 01 00 00 00 00 02 C0 00
    39 01 00 00 00 00 02 C1 1F
    39 01 00 00 00 00 02 C2 2e
    39 01 00 00 00 00 02 C3 11
    39 01 00 00 00 00 02 C4 13
    39 01 00 00 00 00 02 C5 27
    39 01 00 00 00 00 02 C6 1b
    39 01 00 00 00 00 02 C7 1b
    39 01 00 00 00 00 02 C8 8C
    39 01 00 00 00 00 02 C9 1C
    39 01 00 00 00 00 02 CA 29
    39 01 00 00 00 00 02 CB 80
    39 01 00 00 00 00 02 CC 1A
    39 01 00 00 00 00 02 CD 1A   
    39 01 00 00 00 00 02 CE 4E
    39 01 00 00 00 00 02 CF 23
    39 01 00 00 00 00 02 D0 29
    39 01 00 00 00 00 02 D1 59
    39 01 00 00 00 00 02 D2 67
    39 01 00 00 00 00 02 D3 39
    39 01 00 00 00 00 04 FF 98 81 00
    05 01 00 00 78 00 02 11 00
	05 01 00 00 0A 00 02 29 00];
		qcom,mdss-dsi-off-command = [05 01 00 00 0A 00 02 28 00
					05 01 00 00 78 00 02 10 00];
		qcom,mdss-dsi-on-command-state = "dsi_lp_mode";
		qcom,mdss-dsi-off-command-state = "dsi_hs_mode";
		qcom,mdss-dsi-h-sync-pulse = <1>;
		qcom,mdss-dsi-traffic-mode = "burst_mode";
		qcom,mdss-dsi-lane-map = "lane_map_0123";
		qcom,mdss-dsi-bllp-eof-power-mode;
		qcom,mdss-dsi-bllp-power-mode;
		qcom,mdss-dsi-lane-0-state;
		qcom,mdss-dsi-lane-1-state;
		qcom,mdss-dsi-lane-2-state;
		qcom,mdss-dsi-panel-timings = [A4 24 18 00 4E 52 1C 28 1C 03 04 00];
		qcom,mdss-dsi-t-clk-post = <0x03>;
		qcom,mdss-dsi-t-clk-pre = <0x1D>;
		qcom,mdss-dsi-bl-min-level = <1>;
		qcom,mdss-dsi-bl-max-level = <255>;
		qcom,mdss-dsi-bl-pmic-pwm-frequency = <30>;
		qcom,mdss-dsi-bl-pmic-bank-select = <0>;
		qcom,mdss-dsi-dma-trigger = "trigger_sw";
		qcom,mdss-dsi-mdp-trigger = "none";
		qcom,mdss-dsi-bl-pmic-control-type = "bl_ctrl_pwm";
		qcom,mdss-dsi-reset-sequence = <1 5>, <0 10>, <1 120>;
	};
};
