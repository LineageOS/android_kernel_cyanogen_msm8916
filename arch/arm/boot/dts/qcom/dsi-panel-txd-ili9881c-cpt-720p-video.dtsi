/* Copyright (c) 2013, The Linux Foundation. All rights reserved.
 *
 * This program is free software; you can redistribute it and/or modify
 * it under the terms of the GNU General Public License version 2 and
 * only version 2 as published by the Free Software Foundation.
 *
 * This program is distributed in the hope that it will be useful,
 * but WITHOUT ANY WARRANTY; without even the implied warranty of
 * MERCHANTABILITY or FITNESS FOR A PARTICULAR PURPOSE.  See the
 * GNU General Public License for more details.
 */

/*---------------------------------------------------------------------------
 * This file is autogenerated file using gcdb parser. Please do not edit it.
 * Update input XML file to add a new entry or update variable in this file
 * VERSION = "1.0"
 *---------------------------------------------------------------------------*/
&mdss_mdp {
	dsi_txd_ili9881c_720p_cpt_video: qcom,mdss_dsi_txd_ili9881c_720p_cpt_video {
		qcom,mdss-dsi-panel-name = "txd_ili9881c_720p_cpt_video_mode_dsi_panel";
		qcom,mdss-dsi-panel-controller = <&mdss_dsi0>;
		qcom,mdss-dsi-panel-type = "dsi_video_mode";
		qcom,mdss-dsi-panel-destination = "display_1";
		qcom,mdss-dsi-panel-framerate = <60>;
		qcom,mdss-dsi-virtual-channel-id = <0>;
		qcom,mdss-dsi-stream = <0>;
		qcom,mdss-dsi-panel-width = <720>;
		qcom,mdss-dsi-panel-height = <1280>;
		qcom,mdss-dsi-h-front-porch = <80>;
		qcom,mdss-dsi-h-back-porch = <80>;
		qcom,mdss-dsi-h-pulse-width = <60>;
		qcom,mdss-dsi-h-sync-skew = <0>;
		qcom,mdss-dsi-v-back-porch = <18>;
		qcom,mdss-dsi-v-front-porch = <10>;
		qcom,mdss-dsi-v-pulse-width = <4>;
		qcom,mdss-dsi-h-left-border = <0>;
		qcom,mdss-dsi-h-right-border = <0>;
		qcom,mdss-dsi-v-top-border = <0>;
		qcom,mdss-dsi-v-bottom-border = <0>;
		qcom,mdss-dsi-bpp = <24>;
		qcom,mdss-dsi-color-order = "rgb_swap_rgb";
		qcom,mdss-dsi-underflow-color = <0xff>;
		qcom,mdss-dsi-border-color = <0>;
		qcom,mdss-dsi-on-command = [\
		39 01 00 00 00 00 04   FF 98 81 03 
		39 01 00 00 00 00 02   01 00                                    
		39 01 00 00 00 00 02   02 00                                  
		39 01 00 00 00 00 02   03 53                                   
		39 01 00 00 00 00 02   04 14                                   
		39 01 00 00 00 00 02   05 00                                   
		39 01 00 00 00 00 02   06 06                                   
		39 01 00 00 00 00 02   07 01                                  
		39 01 00 00 00 00 02   08 00                                   
		39 01 00 00 00 00 02   09 01                                   
		39 01 00 00 00 00 02   0a 19                                  
		39 01 00 00 00 00 02   0b 01                                   
		39 01 00 00 00 00 02   0c 00                                   
		39 01 00 00 00 00 02   0d 00                                   
		39 01 00 00 00 00 02   0e 00                                   
		39 01 00 00 00 00 02   0f 19                                   
		39 01 00 00 00 00 02   10 19                                   
		39 01 00 00 00 00 02   11 00                                   
		39 01 00 00 00 00 02   12 00                                   
		39 01 00 00 00 00 02   13 00                                  
		39 01 00 00 00 00 02   14 00                                   
		39 01 00 00 00 00 02   15 00                                   
		39 01 00 00 00 00 02   16 00                                   
		39 01 00 00 00 00 02   17 00                                   
		39 01 00 00 00 00 02   18 00                                  
		39 01 00 00 00 00 02   19 00                                   
		39 01 00 00 00 00 02   1a 00                                   
		39 01 00 00 00 00 02   1b 00                                   
		39 01 00 00 00 00 02   1c 00                                   
		39 01 00 00 00 00 02   1d 00                                   
		39 01 00 00 00 00 02   1e 40                                   
		39 01 00 00 00 00 02   1f 40                                   
		39 01 00 00 00 00 02   20 02                                   
		39 01 00 00 00 00 02   21 05                                  
		39 01 00 00 00 00 02   22 02                                  
		39 01 00 00 00 00 02   23 00                                   
		39 01 00 00 00 00 02   24 87                                   
		39 01 00 00 00 00 02   25 87                                   
		39 01 00 00 00 00 02   26 00                                   
		39 01 00 00 00 00 02   27 00                                   
		39 01 00 00 00 00 02   28 3B                                   
		39 01 00 00 00 00 02   29 03                                   
		39 01 00 00 00 00 02   2a 00                                   
		39 01 00 00 00 00 02   2b 00                                   
		39 01 00 00 00 00 02   2c 00                                   
		39 01 00 00 00 00 02   2d 00                                   
		39 01 00 00 00 00 02   2e 00                                   
		39 01 00 00 00 00 02   2f 00                                   
		39 01 00 00 00 00 02   30 00                                   
		39 01 00 00 00 00 02   31 00                                   
		39 01 00 00 00 00 02   32 00                                   
		39 01 00 00 00 00 02   33 00                                   
		39 01 00 00 00 00 02   34 04                                   
		39 01 00 00 00 00 02   35 00                                   
		39 01 00 00 00 00 02   36 00                                   
		39 01 00 00 00 00 02   37 00                                   
		39 01 00 00 00 00 02   38 01                                   
		39 01 00 00 00 00 02   39 01                                   
		39 01 00 00 00 00 02   3a 40                                   
		39 01 00 00 00 00 02   3b 40                                   
		39 01 00 00 00 00 02   3c 00                                   
		39 01 00 00 00 00 02   3d 00                                  
		39 01 00 00 00 00 02   3e 00                                   
		39 01 00 00 00 00 02   3f 00                                  
		39 01 00 00 00 00 02   40 00                                   
		39 01 00 00 00 00 02   41 88                                   
		39 01 00 00 00 00 02   42 00                                   
		39 01 00 00 00 00 02   43 00                                   
		39 01 00 00 00 00 02   44 00                                   
		39 01 00 00 00 00 02   50 01                                   
		39 01 00 00 00 00 02   51 23                                   
		39 01 00 00 00 00 02   52 45                                   
		39 01 00 00 00 00 02   53 67                                   
		39 01 00 00 00 00 02   54 89                                   
		39 01 00 00 00 00 02   55 ab                                   
		39 01 00 00 00 00 02   56 01                                   
		39 01 00 00 00 00 02   57 23                                   
		39 01 00 00 00 00 02   58 45                                   
		39 01 00 00 00 00 02   59 67                                   
		39 01 00 00 00 00 02   5a 89                                   
		39 01 00 00 00 00 02   5b ab                                   
		39 01 00 00 00 00 02   5c cd                                   
		39 01 00 00 00 00 02   5d ef                                   
		39 01 00 00 00 00 02   5e 11                                   
		39 01 00 00 00 00 02   5f 06                                   
		39 01 00 00 00 00 02   60 0C                                   
		39 01 00 00 00 00 02   61 0D                                   
		39 01 00 00 00 00 02   62 0E                                   
		39 01 00 00 00 00 02   63 0F                                   
		39 01 00 00 00 00 02   64 02                                   
		39 01 00 00 00 00 02   65 02                                   
		39 01 00 00 00 00 02   66 02                                   
		39 01 00 00 00 00 02   67 02                                   
		39 01 00 00 00 00 02   68 02                                   
		39 01 00 00 00 00 02   69 02                                  
		39 01 00 00 00 00 02   6a 02                                   
		39 01 00 00 00 00 02   6b 02                                   
		39 01 00 00 00 00 02   6c 02                                   
		39 01 00 00 00 00 02   6d 02                                   
		39 01 00 00 00 00 02   6e 05                                   
		39 01 00 00 00 00 02   6f 05                                   
		39 01 00 00 00 00 02   70 05                                   
		39 01 00 00 00 00 02   71 02                                  
		39 01 00 00 00 00 02   72 01                                   
		39 01 00 00 00 00 02   73 00                                   
		39 01 00 00 00 00 02   74 08                                   
		39 01 00 00 00 00 02   75 08                                   
		39 01 00 00 00 00 02   76 0C                                   
		39 01 00 00 00 00 02   77 0D                                  
		39 01 00 00 00 00 02   78 0E                                   
		39 01 00 00 00 00 02   79 0F                                   
		39 01 00 00 00 00 02   7a 02                                   
		39 01 00 00 00 00 02   7b 02                                   
		39 01 00 00 00 00 02   7c 02                                   
		39 01 00 00 00 00 02   7d 02                                   
		39 01 00 00 00 00 02   7e 02                                   
		39 01 00 00 00 00 02   7f 02                                   
		39 01 00 00 00 00 02   80 02                                   
		39 01 00 00 00 00 02   81 02                                   
		39 01 00 00 00 00 02   82 02                                   
		39 01 00 00 00 00 02   83 02                                   
		39 01 00 00 00 00 02   84 05                                   
		39 01 00 00 00 00 02   85 05                                   
		39 01 00 00 00 00 02   86 05                                   
		39 01 00 00 00 00 02   87 02                                   
		39 01 00 00 00 00 02   88 01                                   
		39 01 00 00 00 00 02   89 00                                   
		39 01 00 00 00 00 02   8A 06                                   
		39 01 00 00 00 00 04   FF 98 81 04                                
		39 01 00 00 00 00 02   00 00                                   
		39 01 00 00 00 00 02   6C 15                                   
		39 01 00 00 00 00 02 6E 32  
		39 01 00 00 00 00 02 6F 45  
		39 01 00 00 00 00 02   3A A4                                   
		39 01 00 00 00 00 02 8D 19  
		39 01 00 00 00 00 02   87 BA                                   
		39 01 00 00 00 00 02   26 76                                   
		39 01 00 00 00 00 02   B2 D1                                   
		39 01 00 00 00 00 04   FF 98 81 01                                 
		39 01 00 00 00 00 02   22 0A                                   
		39 01 00 00 00 00 02 53 9A  
		39 01 00 00 00 00 02   55 A5                                   
		39 01 00 00 00 00 02   50 B9                                   
		39 01 00 00 00 00 02 51 B5  
		39 01 00 00 00 00 02   31 00                                   
		39 01 00 00 00 00 02   60 14                                   
		39 01 00 00 00 00 02   A0 1D                                   
		39 01 00 00 00 00 02 A1 35  
		39 01 00 00 00 00 02 A2 42  
		39 01 00 00 00 00 02 A3 10  
		39 01 00 00 00 00 02 A4 12  
		39 01 00 00 00 00 02 A5 25  
		39 01 00 00 00 00 02 A6 19  
		39 01 00 00 00 00 02   A7 1B                                   
		39 01 00 00 00 00 02 A8 AA  
		39 01 00 00 00 00 02 A9 1B  
		39 01 00 00 00 00 02 AA 28  
		39 01 00 00 00 00 02 AB 99  
		39 01 00 00 00 00 02   AC 1B                                   
		39 01 00 00 00 00 02 AD 1A  
		39 01 00 00 00 00 02 AE 4D  
		39 01 00 00 00 00 02 AF 21  
		39 01 00 00 00 00 02 B0 27  
		39 01 00 00 00 00 02 B1 60  
		39 01 00 00 00 00 02 B2 6E  
		39 01 00 00 00 00 02   B3 39                                   
		39 01 00 00 00 00 02   C0 1D                                   
		39 01 00 00 00 00 02 C1 35  
		39 01 00 00 00 00 02 C2 42  
		39 01 00 00 00 00 02   C3 10                                   
		39 01 00 00 00 00 02 C4 12  
		39 01 00 00 00 00 02   C5 25                                   
		39 01 00 00 00 00 02 C6 19  
		39 01 00 00 00 00 02 C7 1B  
		39 01 00 00 00 00 02 C8 AA  
		39 01 00 00 00 00 02 C9 1B  
		39 01 00 00 00 00 02 CA 28  
		39 01 00 00 00 00 02 CB 99  
		39 01 00 00 00 00 02 CC 1B  
		39 01 00 00 00 00 02 CD 1A  
		39 01 00 00 00 00 02 CE 4D  
		39 01 00 00 00 00 02 CF 21  
		39 01 00 00 00 00 02 D0 27  
		39 01 00 00 00 00 02 D1 60  
		39 01 00 00 00 00 02 D2 6E  
		39 01 00 00 00 00 02   D3 39  
		39 01 00 00 00 00 04   FF 98 81 00 
		39 01 00 00 00 00 02   35 00  
		05 01 00 00 78 00 02 11 00                        
		05 01 00 00 0A 00 02 29 00                             
			];
		qcom,mdss-dsi-off-command = [05 01 00 00 0A 00 02 28 00
					05 01 00 00 78 00 02 10 00];
		qcom,mdss-dsi-on-command-state = "dsi_lp_mode";
		qcom,mdss-dsi-off-command-state = "dsi_hs_mode";
		qcom,mdss-dsi-h-sync-pulse = <1>;
		qcom,mdss-dsi-traffic-mode = "burst_mode";
		qcom,mdss-dsi-lane-map = "lane_map_0123";
		qcom,mdss-dsi-bllp-eof-power-mode;
		qcom,mdss-dsi-bllp-power-mode;
		qcom,mdss-dsi-lane-0-state;
		qcom,mdss-dsi-lane-1-state;
		qcom,mdss-dsi-lane-2-state;
/*                  qcom,mdss-dsi-panel-status-command1 = [06 01 00 01 05 00 02 0A 00];*/
/*		qcom,mdss-dsi-panel-status-value = <0x9C 0x00 0x00 0x00>;*/
/*		qcom,mdss-dsi-panel-status-command-state = "dsi_lp_mode";*/
/*		qcom,mdss-dsi-panel-status-check-mode = "reg_read";   */
/*		qcom,mdss-dsi-panel-status-value-rlen = <4>;*/
/*		qcom,mdss-dsi-panel-status-command-num = <1>;*/
		qcom,mdss-dsi-panel-timings = [A4 24 18 00 4E 52 1C 28 1C 03 04 00];
		qcom,mdss-dsi-t-clk-post = <0x03>;
		qcom,mdss-dsi-t-clk-pre = <0x1D>;
		qcom,mdss-dsi-bl-min-level = <1>;
		qcom,mdss-dsi-bl-max-level = <255>;
		qcom,mdss-dsi-bl-pmic-pwm-frequency = <30>;
		qcom,mdss-dsi-bl-pmic-bank-select = <0>;
		qcom,mdss-dsi-dma-trigger = "trigger_sw";
		qcom,mdss-dsi-mdp-trigger = "none";
		qcom,mdss-dsi-bl-pmic-control-type = "bl_ctrl_pwm";
		qcom,mdss-dsi-reset-sequence = <1 5>, <0 10>, <1 120>;
	};
};
