## arch/arm/fastcharge/Kconfig
```kconfig
config FORCE_FAST_CHARGE
	bool "Force faster charge rate for AC/USB"
	default y
	help
	  This allows users to override default charge rate for both USB and AC
	  charger input current
```
